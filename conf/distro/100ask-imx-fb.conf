## conf/distro/100ask-imx-fb.conf
```bitbake
# i.MX DISTRO for the FrameBuffer graphical backend.

include conf/distro/include/100ask-imx-base.inc
include conf/distro/include/100ask-imx-preferred-env.inc

DISTRO = "100ask-imx-fb"

# Remove conflicting backends.
DISTRO_FEATURES_remove = "x11 wayland directfb "
```

## conf/layer.conf
```bitbake
# We have a conf and classes directory, add to BBPATH
BBPATH .= ":${LAYERDIR}"

# We have recipes-* directories, add to BBFILES
BBFILES += "${LAYERDIR}/recipes-*/*/*.bb \
	${LAYERDIR}/recipes-*/*/*.bbappend"

BBFILE_COLLECTIONS += "100ask-fsl"
BBFILE_PATTERN_100ask-fsl = "^${LAYERDIR}/"
BBFILE_PRIORITY_100ask-fsl = "9"
```
